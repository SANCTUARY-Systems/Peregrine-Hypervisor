/* SPDX-FileCopyrightText: 2019 The Hafnium Authors.     */
/* SPDX-FileCopyrightText: 2023 SANCTUARY Systems GmbH.  */
/* SPDX-License-Identifier: GPL-2.0-only */

/dts-v1/;

/ {
	hypervisor {
		compatible = "hafnium,hafnium";
		vm1 {
			debug_name = "gicv3_test";
			kernel_filename = "gicv3_test";
		};

		vm2 {
			debug_name = "services1";
			vcpu_count = <1>;
			mem_size = <0x100000>;
			kernel_filename = "services1";
			fdt_filename = "secondary.dtb";
		};
	};
};
