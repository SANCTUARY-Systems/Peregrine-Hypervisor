/* SPDX-FileCopyrightText: 2020 The Hafnium Authors.     */
/* SPDX-FileCopyrightText: 2023 SANCTUARY Systems GmbH.  */
/* SPDX-License-Identifier: BSD-3-Clause OR GPL-2.0-only */

/* A minimal FDT for the unit tests to work. */

/dts-v1/;

/ {
        #size-cells = <0x02>;
        #address-cells = <0x02>;
        compatible = "linux,dummy-virt";

        psci {
                #size-cells = <0x01>;
                #address-cells = <0x01>;
                migrate = <0xc4000005>;
                cpu_on = <0xc4000003>;
                cpu_off = <0x84000002>;
                cpu_suspend = <0xc4000001>;
                method = "smc";
                compatible = "arm,psci-1.1\0arm,psci";
        };

        cpus {
                #size-cells = <0>;
                #address-cells = <1>;

                cpu@0 {
                        reg = <0>;
                        enable-method = "psci";
                        compatible = "arm,cortex-a57";
                        device_type = "cpu";
                };
        };
};
