/* SPDX-FileCopyrightText: 2019 The Hafnium Authors.     */
/* SPDX-FileCopyrightText: 2023 SANCTUARY Systems GmbH.  */
/* SPDX-License-Identifier: GPL-2.0-only */

/dts-v1/;

/ {
	hypervisor {
		compatible = "hafnium,hafnium";
		vm1 {
			debug_name = "aarch64_test";
			kernel_filename = "aarch64_test";

			smc_whitelist = <
				0x30000001
				0x30000002
				0x30000003
				0x30000004
				>;
		};
	};
};
