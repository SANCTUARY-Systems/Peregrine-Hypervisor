/* SPDX-FileCopyrightText: 2020 The Hafnium Authors.     */
/* SPDX-FileCopyrightText: 2023 SANCTUARY Systems GmbH.  */
/* SPDX-License-Identifier: GPL-2.0-only */

/dts-v1/;

/ {
	hypervisor {
		compatible = "hafnium,hafnium";
		ffa_tee;
		vm1 {
			debug_name = "trusty_test";
			kernel_filename = "trusty_test";
		};
	};
};
